#include <Arduino.h>
#include <U8g2lib.h>

#ifdef U8X8_HAVE_HW_SPI
#include <SPI.h>
#endif
#ifdef U8X8_HAVE_HW_I2C
#include <Wire.h>
#endif

U8G2_SSD1306_128X32_UNIVISION_F_HW_I2C u8g2(U8G2_R0, /* reset=*/ U8X8_PIN_NONE); 

#define schnecke_width 50
#define schnecke_height 50
static unsigned char schnecke_bits[] = {
   0x00, 0x00, 0x00, 0x00, 0x00, 0x00, 0x00, 0x00, 0x00, 0x2a, 0x00, 0x00,
   0x00, 0x00, 0x00, 0x60, 0x91, 0x01, 0x00, 0x00, 0x00, 0x00, 0x0c, 0x00,
   0x04, 0x00, 0x00, 0x00, 0x00, 0x01, 0x00, 0x08, 0x00, 0x00, 0x00, 0x00,
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   0x00, 0x00 };
  
   
   

   
   


void setup() {
 Wire.begin();
 u8g2.begin();

}

void loop() {
  u8g2.firstPage();
  do{
    u8g2.drawXBMP(0,0,schnecke_width,schnecke_height,schnecke_bits);
    delay(1000);
    
    }while(u8g2.nextPage());
    u8g2.firstPage();
  do{
    u8g2.drawXBMP(20,0,schnecke_width,schnecke_height,schnecke_bits);
    delay(1000);
    
    }while(u8g2.nextPage());
    u8g2.firstPage();
  do{
    u8g2.drawXBMP(30,0,schnecke_width,schnecke_height,schnecke_bits);
    delay(1000);
    
    }while(u8g2.nextPage());
    u8g2.firstPage();
  do{
    u8g2.drawXBMP(40,0,schnecke_width,schnecke_height,schnecke_bits);
    delay(1000);
    
    }while(u8g2.nextPage());
    u8g2.firstPage();
  do{
    u8g2.drawXBMP(50,0,schnecke_width,schnecke_height,schnecke_bits);
    delay(1000);
    
    }while(u8g2.nextPage());

}
